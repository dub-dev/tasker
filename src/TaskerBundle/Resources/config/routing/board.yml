## src/TaskerBundle/Resources/config/routing/board.yml
```yaml
board:
    path:     /
    defaults: { _controller: "TaskerBundle:Board:index" }

board_show:
    path:     /{id}/show
    defaults: { _controller: "TaskerBundle:Board:show" }

board_new:
    path:     /new
    defaults: { _controller: "TaskerBundle:Board:new" }

board_create:
    path:     /create
    defaults: { _controller: "TaskerBundle:Board:create" }
    methods:  POST

board_edit:
    path:     /{id}/edit
    defaults: { _controller: "TaskerBundle:Board:edit" }

board_update:
    path:     /{id}/update
    defaults: { _controller: "TaskerBundle:Board:update" }
    methods:  [POST, PUT]

board_delete:
    path:     /{id}/delete
    defaults: { _controller: "TaskerBundle:Board:delete" }
    methods:  [POST, DELETE]
```
